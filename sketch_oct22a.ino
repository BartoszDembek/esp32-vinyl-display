#include <Arduino.h>
#include <WiFi.h>
#include <WiFiManager.h>
#include <HTTPClient.h>
#include <WiFiClientSecure.h>
#include <driver/i2s.h>

#define ENABLE_GxEPD2_GFX 0
#include <GxEPD2_BW.h>
#include <Fonts/FreeMonoBold12pt7b.h>
#include <Fonts/FreeMonoBold18pt7b.h>
#include "Petme8x8.h"

// Piny e-paper
#define EPD_CS    10
#define EPD_DC    13
#define EPD_RST   14
#define EPD_BUSY  9

#define GxEPD2_DRIVER_CLASS GxEPD2_420_GDEY042T81

GxEPD2_BW<GxEPD2_DRIVER_CLASS, GxEPD2_DRIVER_CLASS::HEIGHT> display(
  GxEPD2_DRIVER_CLASS(EPD_CS, EPD_DC, EPD_RST, EPD_BUSY)
);

// ===== Piny INMP441 =====
#define I2S_WS    16
#define I2S_SCK   15
#define I2S_SD    17

#define SAMPLE_RATE     16000
#define RECORD_SECONDS  8
#define RECORD_INTERVAL 120000UL  // 2 minuty

const char* AUDD_TOKEN = "token";

enum State {
  STATE_START,
  STATE_CONNECTING,
  STATE_CONNECTED,
  STATE_RECORDING,
  STATE_RECOGNIZING,
  STATE_RESULT,
  STATE_ERROR
};



State currentState = STATE_START;
unsigned long lastRecordTime = 0;

// Bufor na nagranie (ok. 256 KB)
const int totalSamples = SAMPLE_RATE * RECORD_SECONDS;
int16_t* audioBuffer = nullptr;

struct SongInfo {
  String title;
  String artist;
  String album;
  bool found = false;
  bool networkError = false;
  bool micError = false;
};

bool debug = false;

SongInfo debug_value;

void drawCenteredText(const String& text, int y, int textSize, int maxWidth) {
  display.setTextSize(textSize);
  display.setFont(&Petme8x8);

  String toDraw = text;

  // Obcinanie z "..."
  int16_t x1, y1;
  uint16_t w, h;
  display.getTextBounds(toDraw, 0, 0, &x1, &y1, &w, &h);

  while (w > maxWidth && toDraw.length() > 3) {
    toDraw = toDraw.substring(0, toDraw.length() - 1);
    display.getTextBounds(toDraw + "...", 0, 0, &x1, &y1, &w, &h);
  }
  if (toDraw != text) {
    toDraw += "...";
  }

  // Wyśrodkowanie
  display.getTextBounds(toDraw, 0, 0, &x1, &y1, &w, &h);
  int x = (display.width() - w) / 2;
  if (x < 0) x = 0;

  display.setCursor(x, y);
  display.print(toDraw);
}

static const unsigned char PROGMEM image_streamline_music_album_cd_disk_playlist__music_audio_png_bits[] = {0x00,0x00,0x00,0x00,0x00,0x00,0x00,0x00,0x00,0x00,0x00,0x00,0x00,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0x00,0x00};

void drawScreen_1(SongInfo song) {
    display.fillScreen(GxEPD_WHITE);
    int maxWidth = display.width() - 20;
    // Artist Name
    display.setTextColor(GxEPD_BLACK);
    display.setTextSize(2);
    display.setTextWrap(false);
    display.setFont(&Petme8x8);
    drawCenteredText(song.artist, 141, 2, maxWidth);
    // Song Title
    drawCenteredText(song.title, 102, 3, maxWidth);
    // Album Name
    drawCenteredText(song.album, 176, 2, maxWidth);
    // streamline-music-album-cd-disk-playlist--music-audio.png
    display.drawBitmap(156, 184, image_streamline_music_album_cd_disk_playlist__music_audio_png_bits, 88, 88, GxEPD_BLACK);
    display.display();
}


static const unsigned char PROGMEM image_wifi_full_bits[] = {0x00,0x00,0x00,0x00,0x00,0x00,0x00,0x0f,0xff,0xff,0xff,0xff,0xfc,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0x00,0x00};

void drawScreen_2(void) {
    display.fillScreen(GxEPD_WHITE);
    // string 6
    display.setTextColor(GxEPD_BLACK);
    display.setTextSize(2);
    display.setTextWrap(false);
    display.setFont(&Petme8x8);
    display.setCursor(56, 249);
    display.print("Laczenie z WiFi...");
    // wifi_full
    display.drawBitmap(119, 82, image_wifi_full_bits, 162, 136, GxEPD_BLACK);
    display.display();
}

static const unsigned char PROGMEM image_microphone_recording_bits[] = {0x00,0x01,0xfe,0x00,0x00,0x07,0xff,0xff,0xf0,0x00,0x00,0x3f,0xc0,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0x00,0x00};

void drawScreen_3(void) {
    display.fillScreen(GxEPD_WHITE);
    // string 6
    display.setTextColor(GxEPD_BLACK);
    display.setTextSize(2);
    display.setTextWrap(false);
    display.setFont(&Petme8x8);
    display.setCursor(96, 249);
    display.print("Nasluchiwanie");
    // microphone_recording
    display.drawBitmap(144, 82, image_microphone_recording_bits, 113, 121, GxEPD_BLACK);
    display.display();
}

static const unsigned char PROGMEM image_streamline_entertainment_events_hobbies_record_player__entertainment_events_hobbies_png_bits[] = {0x00,0x00,0x7f,0xff,0xff,0xff,0xff,0xff,0xff,0xff,0xff,0xff,0xff,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0x00,0x00};

void drawScreen_4(void) {
    display.fillScreen(GxEPD_WHITE);
    // streamline-entertainment-events-hobbies-record-player--entertainment-events-hobbies.png
    display.drawBitmap(111, 34, image_streamline_entertainment_events_hobbies_record_player__entertainment_events_hobbies_png_bits, 178, 178, GxEPD_BLACK);
    // string 10
    display.setTextColor(GxEPD_BLACK);
    display.setTextSize(3);
    display.setTextWrap(false);
    display.setFont(&Petme8x8);
    display.setCursor(8, 257);
    display.print("Song Recognition");
    // string 11
    display.setTextSize(1);
    display.setCursor(318, 292);
    display.print("By Bartek");
    display.display();
}

static const unsigned char PROGMEM image_file_search_bits[] = {0x00,0x00,0x00,0x00,0x00,0x00,0x07,0xff,0xff,0xff,0xff,0xe0,0x00,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0x00,0x00};

void drawScreen_5(void) {
    display.fillScreen(GxEPD_WHITE);
    // string 6
    display.setTextColor(GxEPD_BLACK);
    display.setTextSize(2);
    display.setTextWrap(false);
    display.setFont(&Petme8x8);
    display.setCursor(96, 249);
    display.print("Rozpoznawanie");
    // file_search
    display.drawBitmap(143, 83, image_file_search_bits, 114, 122, GxEPD_BLACK);
    display.display();
}

static const unsigned char PROGMEM image_operation_error_bits[] = {0x00,0x00,0x00,0x07,0xff,0xff,0xff,0xff,0xff,0xff,0x00,0x00,0x00,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0x00,0x00};

void drawScreen_6(void) {
    display.fillScreen(GxEPD_WHITE);
    // string 6
    display.setTextColor(GxEPD_BLACK);
    display.setTextSize(2);
    display.setTextWrap(false);
    display.setFont(&Petme8x8);
    display.setCursor(32, 249);
    display.print("Nie rozpoznano utworu");
    // operation_error
    display.drawBitmap(146, 88, image_operation_error_bits, 109, 116, GxEPD_BLACK);
    display.display();
}

static const unsigned char PROGMEM image_streamline_internet_network_cloud_error__internet_network_png_bits[] = {0x00,0x00,0x00,0x00,0x00,0x00,0x00,0x00,0x00,0x00,0x00,0x00,0x00,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0x00,0x00};

void drawScreen_7(void) {
    display.fillScreen(GxEPD_WHITE);
    // string 6
    display.setTextColor(GxEPD_BLACK);
    display.setTextSize(2);
    display.setTextWrap(false);
    display.setFont(&Petme8x8);
    display.setCursor(80, 218);
    display.print("Blad polaczenia");
    // streamline-internet-network-cloud-error--internet-network.png
    display.drawBitmap(137, 70, image_streamline_internet_network_cloud_error__internet_network_png_bits, 126, 126, GxEPD_BLACK);
    // string 18
    display.setTextSize(1);
    display.setCursor(140, 242);
    display.print("z serwerem AudD");
    display.display();
}

static const unsigned char PROGMEM image_microphone_muted_bits[] = {0xfe,0x00,0x00,0x00,0x3f,0xff,0xfe,0x00,0x00,0x00,0x00,0x00,0x00,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0x00,0x00};

void drawScreen_8(void) {
    display.fillScreen(GxEPD_WHITE);
    // string 6
    display.setTextColor(GxEPD_BLACK);
    display.setTextSize(2);
    display.setTextWrap(false);
    display.setFont(&Petme8x8);
    display.setCursor(88, 249);
    display.print("Blad mikrofonu");
    // microphone_muted
    display.drawBitmap(149, 94, image_microphone_muted_bits, 103, 110, GxEPD_BLACK);
    display.display();
}


void initMic() {
  i2s_config_t i2s_config = {
    .mode = (i2s_mode_t)(I2S_MODE_MASTER | I2S_MODE_RX),
    .sample_rate = 16000,
    .bits_per_sample = I2S_BITS_PER_SAMPLE_16BIT,
    .channel_format = I2S_CHANNEL_FMT_ONLY_LEFT,
    .communication_format = I2S_COMM_FORMAT_STAND_I2S,
    .intr_alloc_flags = ESP_INTR_FLAG_LEVEL1,
    .dma_buf_count = 8,
    .dma_buf_len = 64,
    .use_apll = false,
    .tx_desc_auto_clear = false,
    .fixed_mclk = 0
  };

  i2s_pin_config_t pin_config = {
    .bck_io_num = I2S_SCK,
    .ws_io_num = I2S_WS,
    .data_out_num = I2S_PIN_NO_CHANGE,
    .data_in_num = I2S_SD
  };

  i2s_driver_install(I2S_NUM_0, &i2s_config, 0, NULL);
  i2s_set_pin(I2S_NUM_0, &pin_config);
  i2s_zero_dma_buffer(I2S_NUM_0);
}

void drawScreen(const char* title, const char* subtitle = "") {
  display.setFullWindow();
  display.firstPage();
  do {
    display.fillScreen(GxEPD_WHITE);
    display.setTextColor(GxEPD_BLACK);
    display.setFont(&FreeMonoBold18pt7b);
    display.setCursor(15, 70);
    display.print(title);

    if (subtitle && subtitle[0] != '\0') {
      display.setFont(&FreeMonoBold12pt7b);
      display.setCursor(15, 110);
      display.print(subtitle);
    }
  } while (display.nextPage());
  display.hibernate();
}

void setState(State newState, SongInfo info = SongInfo()) {
  currentState = newState;
  switch (currentState) {
    case STATE_START:        drawScreen_4(); break;
    case STATE_CONNECTING:   drawScreen_2(); break;
    case STATE_RECORDING:    drawScreen_3(); break;
    case STATE_RECOGNIZING:  drawScreen_5(); break;
    case STATE_RESULT:
      if (info.found) {
        drawScreen_1(info);
      } else if (info.networkError) {
        drawScreen_7();
      } else if (info.micError) {
        drawScreen_8();
      } else {
        drawScreen_6();
      }
      break;
    case STATE_ERROR: drawScreen("Blad"); break;
  }
}

bool recordAudio() {
  setState(STATE_RECORDING);
  if (!audioBuffer) audioBuffer = (int16_t*)ps_malloc(totalSamples * sizeof(int16_t));
  if (!audioBuffer) {
    Serial.println("Brak PSRAM!");
    return false;
  }

  Serial.println("Nagrywam...");
  size_t bytesRead;
  int zeroCount = 0;
  int validSamples = 0;

  for (int i = 0; i < totalSamples; i++) {
    esp_err_t err = i2s_read(I2S_NUM_0, &audioBuffer[i], sizeof(int16_t), &bytesRead, pdMS_TO_TICKS(100));
    if (err != ESP_OK || bytesRead == 0) {
      zeroCount++;
      audioBuffer[i] = 0;
    } else {
      validSamples++;
      if (audioBuffer[i] == 0) zeroCount++;
    }
  }
  if (validSamples < totalSamples / 4 || zeroCount > totalSamples * 0.9) {
    Serial.println("Blad mikrofonu - brak danych z I2S");
    return false;   // sygnał błędu
  }
  Serial.println("Nagrane.");
  return true;
}

SongInfo recognizeWithAudd() {
  setState(STATE_RECOGNIZING);

  SongInfo info;

  String boundary = "----ESP32Boundary";
  uint32_t dataSize = totalSamples * 2;

  uint8_t wavHeader[44];
  memcpy(wavHeader, "RIFF", 4);
  uint32_t fileSize = 36 + dataSize;
  memcpy(wavHeader + 4, &fileSize, 4);
  memcpy(wavHeader + 8, "WAVEfmt ", 8);
  uint32_t fmtSize = 16;
  memcpy(wavHeader + 16, &fmtSize, 4);
  uint16_t audioFormat = 1;
  memcpy(wavHeader + 20, &audioFormat, 2);
  uint16_t channels = 1;
  memcpy(wavHeader + 22, &channels, 2);
  uint32_t sr = SAMPLE_RATE;
  memcpy(wavHeader + 24, &sr, 4);
  uint32_t byteRate = SAMPLE_RATE * 2;
  memcpy(wavHeader + 28, &byteRate, 4);
  uint16_t blockAlign = 2;
  memcpy(wavHeader + 32, &blockAlign, 2);
  uint16_t bits = 16;
  memcpy(wavHeader + 34, &bits, 2);
  memcpy(wavHeader + 36, "data", 4);
  memcpy(wavHeader + 40, &dataSize, 4);

  String head = "--" + boundary + "\r\n"
                "Content-Disposition: form-data; name=\"api_token\"\r\n\r\n" +
                String(AUDD_TOKEN) + "\r\n"
                "--" + boundary + "\r\n"
                "Content-Disposition: form-data; name=\"file\"; filename=\"audio.wav\"\r\n"
                "Content-Type: audio/wav\r\n\r\n";

  String tail = "\r\n--" + boundary + "--\r\n";
  int contentLength = head.length() + 44 + dataSize + tail.length();

  WiFiClientSecure client;
  client.setInsecure();

  if (!client.connect("api.audd.io", 443)) {
    info.networkError = true;
    info.title = "Blad sieci";
    return info;
  }

  client.print("POST / HTTP/1.1\r\n");
  client.print("Host: api.audd.io\r\n");
  client.print("Content-Type: multipart/form-data; boundary=" + boundary + "\r\n");
  client.print("Content-Length: " + String(contentLength) + "\r\n");
  client.print("Connection: close\r\n\r\n");
  client.print(head);
  client.write(wavHeader, 44);
  client.write((uint8_t*)audioBuffer, dataSize);
  client.print(tail);

  String response = "";
  unsigned long timeout = millis();
  while (client.connected() && millis() - timeout < 15000) {
    while (client.available()) {
      response += (char)client.read();
      timeout = millis();
    }
  }
  client.stop();

  if (response.length() == 0) {
    info.networkError = true;
    info.title = "Blad sieci";
    return info;
  }

  // Prosty parsing JSON
  int titleStart = response.indexOf("\"title\":\"");
  int artistStart = response.indexOf("\"artist\":\"");
  int albumStart = response.indexOf("\"album\":\"");

  if (titleStart == -1) {
    info.title = "Nie rozpoznano";
    return info;
  }

  auto extract = [&](int start, int offset) -> String {
    if (start == -1) return "";
    start += offset;
    int end = response.indexOf("\"", start);
    if (end == -1) return "";
    return response.substring(start, end);
  };

  info.title  = extract(titleStart, 9);
  info.artist = extract(artistStart, 10);
  info.album  = extract(albumStart, 9);
  info.found  = true;

  return info;
}


void setup() {
  Serial.begin(115200);
  delay(500);

  debug_value.title  = "Test";
  debug_value.artist = "Test";
  debug_value.album  = "test";
  debug_value.found  = true;

  SPI.begin(12, -1, 11, EPD_CS);
  display.init(115200, true, 2, false);
  display.setRotation(0);

  setState(STATE_START);
  delay(1800);
  setState(STATE_CONNECTING);

  WiFiManager wm;
  bool ok = wm.autoConnect("ESP32-Setup");

  if (ok) {
    initMic();
    Serial.println("IP: " + WiFi.localIP().toString());
    setState(STATE_CONNECTED);

    // Od razu pierwsze nagranie
    if (recordAudio()) {
      if(!debug){
        SongInfo result = recognizeWithAudd();
        setState(STATE_RESULT, result);
      }
      else{
        SongInfo result = debug_value;
        setState(STATE_RESULT, result);
      }
    } else {
      SongInfo err;
      err.micError = true;
      setState(STATE_RESULT, err);
    }
    lastRecordTime = millis();
  } else {
    setState(STATE_ERROR);
    delay(3000);
    ESP.restart();
  }
}

void loop() {
  if (millis() - lastRecordTime >= RECORD_INTERVAL) {
    if (recordAudio()) {
      if(!debug){
        SongInfo result = recognizeWithAudd();
        setState(STATE_RESULT, result);
        Serial.println(result.title + " - " + result.artist);
      }
      else{
        SongInfo result = debug_value;
        setState(STATE_RESULT, result);
      }
    }
    lastRecordTime = millis();
  }
}